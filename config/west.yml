## config/west.yml
```yaml
manifest:
  remotes:
    - name: zmkfirmware
      url-base: https://github.com/zmk
    - name: spe2
      url-base: https://github.com/spe2
  projects:
    - name: zmk
      remote: spe2
      revision: main
      import: app/west.yml
  self:
    path: config
```
